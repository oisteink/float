## float_core/main/Kconfig.projbuild
```kconfig
menu "Float Core"

    config FLOAT_CORE_BLINK_GPIO
        int "WS2812 blink LED GPIO pin"
        default 8
        help
            GPIO pin connected to the WS2812 LED used for status blink patterns.

endmenu
```

## float_core/sdkconfig.defaults
```kconfig
# Console — UART (output visible on /dev/ttyUSB0)
# USB_SERIAL_JTAG available as secondary output
CONFIG_ESP_CONSOLE_UART_DEFAULT=y

# Partition table
CONFIG_PARTITION_TABLE_SINGLE_APP_LARGE=y

# Flash — octal SPI, 32MB
CONFIG_ESPTOOLPY_OCT_FLASH=y
CONFIG_ESPTOOLPY_FLASHSIZE_32MB=y
CONFIG_ESPTOOLPY_HEADER_FLASHSIZE_UPDATE=y

# PSRAM — octal SPI, 80MHz
CONFIG_SPIRAM=y
CONFIG_SPIRAM_MODE_OCT=y
CONFIG_SPIRAM_SPEED_80M=y

# MSP3520 display SPI (pins 3–9 on header)
# Pin 3:  CS
CONFIG_MSP3520_DISPLAY_CS_GPIO=3
# Pin 4:  RESET
CONFIG_MSP3520_DISPLAY_RST_GPIO=46
# Pin 5:  DC/RS
CONFIG_MSP3520_DISPLAY_DC_GPIO=9
# Pin 6:  SDI (MOSI)
CONFIG_MSP3520_DISPLAY_MOSI_GPIO=10
# Pin 7:  SCK
CONFIG_MSP3520_DISPLAY_SCLK_GPIO=11
# Pin 8:  LED (backlight)
CONFIG_MSP3520_DISPLAY_BKL_GPIO=12
# Pin 9:  SDO (MISO)
CONFIG_MSP3520_DISPLAY_MISO_GPIO=13
CONFIG_MSP3520_DISPLAY_SPI_CLOCK_MHZ=40

# MSP3520 touch SPI (pins 10–14 on header)
# Pin 10: T_CLK
CONFIG_MSP3520_TOUCH_SCLK_GPIO=6
# Pin 11: T_CS
CONFIG_MSP3520_TOUCH_CS_GPIO=4
# Pin 12: T_DIN (MOSI)
CONFIG_MSP3520_TOUCH_MOSI_GPIO=7
# Pin 13: T_DO (MISO)
CONFIG_MSP3520_TOUCH_MISO_GPIO=8
# Pin 14: T_IRQ
CONFIG_MSP3520_TOUCH_IRQ_GPIO=5
CONFIG_MSP3520_TOUCH_SPI_CLOCK_KHZ=2000

# FreeRTOS — 1kHz tick for lower LVGL task latency
CONFIG_FREERTOS_HZ=1000

# Task watchdog — don't watch idle tasks (LVGL task may block)
CONFIG_ESP_TASK_WDT_CHECK_IDLE_TASK_CPU0=n
CONFIG_ESP_TASK_WDT_CHECK_IDLE_TASK_CPU1=n

# Logging — allow DEBUG level at compile time
CONFIG_LOG_MAXIMUM_LEVEL=4

# LVGL
CONFIG_LV_COLOR_DEPTH_24=y
CONFIG_LV_FONT_MONTSERRAT_24=y
CONFIG_LV_FONT_MONTSERRAT_28=y
CONFIG_LV_DEF_REFR_PERIOD=10
CONFIG_LV_BUILD_EXAMPLES=n
CONFIG_LV_BUILD_DEMOS=n
```

## float_node/main/Kconfig.projbuild
```kconfig
menu "Float Node"

    choice FLOAT_NODE_SENSOR
        prompt "Sensor type"
        default FLOAT_NODE_SENSOR_MOCK
        help
            Select the sensor connected to the node.

        config FLOAT_NODE_SENSOR_AHT30
            bool "AHT30 (temperature + humidity)"
        config FLOAT_NODE_SENSOR_BMP280
            bool "BMP280 (temperature + pressure)"
        config FLOAT_NODE_SENSOR_MOCK
            bool "Mock (fixed values, no hardware required)"
    endchoice

    menu "Mock sensor classes"
        visible if FLOAT_NODE_SENSOR_MOCK

        config FLOAT_MOCK_AIR_TEMPERATURE
            bool "Air temperature"
            default y

        config FLOAT_MOCK_AIR_HUMIDITY
            bool "Air humidity"
            default y

        config FLOAT_MOCK_AIR_PRESSURE
            bool "Air pressure"
            default n

        config FLOAT_MOCK_WATER_TEMPERATURE
            bool "Water temperature"
            default n
    endmenu

    config FLOAT_NODE_DEBUG_SLEEP
        bool "Use vTaskDelay loop instead of deep sleep"
        default y
        help
            Keeps USB-JTAG alive for continuous logging during development.
            When disabled, node uses esp_deep_sleep() for production operation.

    config FLOAT_NODE_SLEEP_DURATION_MS
        int "Sleep duration between readings (ms)"
        default 5000
        depends on FLOAT_NODE_DEBUG_SLEEP
        help
            Time to wait between read-send cycles in debug mode.

endmenu
```

## float_node/sdkconfig.defaults
```kconfig
CONFIG_ESP_CONSOLE_USB_SERIAL_JTAG=y
CONFIG_FLOAT_NODE_SENSOR_MOCK=y

# Required by float_node_list (shared component, not used by node but compiled)
CONFIG_LV_FONT_MONTSERRAT_24=y
```

## float_test/sdkconfig.defaults
```kconfig
CONFIG_ESP_TASK_WDT_INIT=n
CONFIG_UNITY_ENABLE_BACKTRACE_ON_FAIL=y
CONFIG_HEAP_POISONING_COMPREHENSIVE=y
CONFIG_COMPILER_STACK_CHECK_MODE_STRONG=y
```
